## src/packages/src/src/fbr/buildroot/package/netcat6/Config.in
```kconfig
config BR2_PACKAGE_NETCAT6
	bool "netcat6"
	help
	  netcat6 is a clone of the original netcat utility. It fully supports
	  IPv6.
```

## src/packages/src/src/fbr/buildroot/package/netecho/Config.in
```kconfig
config BR2_PACKAGE_NETECHO
	bool "netecho"
	help
	  Fli4l-specific utility: Sends one line of text to a given
	  TCP host/port and waits for an answer.
```

## src/packages/src/src/fbr/buildroot/package/netio/Config.in
```kconfig
config BR2_PACKAGE_NETIO
	bool "netio"
	depends on BR2_TOOLCHAIN_HAS_THREADS
	help
	  This is a network benchmark for OS/2 2.x, Windows, Linux and Unix.
	  It measures the net throughput of a network via TCP and UDP
	  protocols using various different packet sizes.

	  http://www.ars.de/ars/ars.nsf/docs/netio

comment "netio needs a toolchain w/ threads"
	depends on !BR2_TOOLCHAIN_HAS_THREADS
```

## src/packages/src/src/fbr/buildroot/package/orinoco-firmware/Config.in
```kconfig
config BR2_PACKAGE_ORINOCO_FIRMWARE
	bool "orinoco-firmware"
	help
	  Firmware for PCMCIA Lucent Orinoco, Prism II based driver
```

## src/packages/src/src/fbr/buildroot/package/ovpnctrl/Config.in
```kconfig
config BR2_PACKAGE_OVPNCTRL
	bool "ovpnctrl"
	help
	  Fli4l-specific utility: Communicates with OpenVPN instances over the
	  management port.
```

## src/packages/src/src/fbr/buildroot/package/p54-pci-firmware/Config.in
```kconfig
config BR2_PACKAGE_P54_PCI_FIRMWARE
	bool "p54-pci-firmware"
	help
	  Firmware for Intersil Prism54 based PCI wifi devices.
```

## src/packages/src/src/fbr/buildroot/package/p54-usb-firmware/Config.in
```kconfig
config BR2_PACKAGE_P54_USB_FIRMWARE
	bool "p54-usb-firmware"
	help
	  Firmware for Intersil Prism54 based USB wifi devices.
```

## src/packages/src/src/fbr/buildroot/package/pcengines-apu/Config.in
```kconfig
config BR2_PACKAGE_PCENGINES_APU
	bool "pcengines-apu"
	depends on BR2_LINUX_KERNEL
	depends on BR2_i386 || BR2_x86_64
	help
	  drivers for PC-Engines APU

comment "pcengines_apu requires a Linux kernel to be built"
	depends on !BR2_LINUX_KERNEL
```

## src/packages/src/src/fbr/buildroot/package/pcengines-wrap/Config.in
```kconfig
config BR2_PACKAGE_PCENGINES_WRAP
	bool "pcengines-wrap"
	depends on BR2_LINUX_KERNEL
	depends on BR2_i386
	help
	  drivers for PC-Engines WRAP

comment "pcengines_wrap requires a Linux kernel to be built"
	depends on !BR2_LINUX_KERNEL
```

## src/packages/src/src/fbr/buildroot/package/pcengines/Config.in
```kconfig
config BR2_PACKAGE_PCENGINES
	bool "pcengines"
	help
	  Fli4l-specific utility: Prints BIOS information on PC Engines
	  machines (WRAP / ALIX).
```

## src/packages/src/src/fbr/buildroot/package/pcmciautils/Config.in
```kconfig
config BR2_PACKAGE_PCMCIAUTILS
	bool "pcmciautils"
	help
	  Utilities to deal with PCMCIA/Cardbus cards.
```

## src/packages/src/src/fbr/buildroot/package/petools/Config.in
```kconfig
config BR2_PACKAGE_PETOOLS
	bool "petools"
	help
	  Tools for analysis and manipulation of PE (Portable Executable) file
	  headers.
```

## src/packages/src/src/fbr/buildroot/package/ppp2i4l/Config.in
```kconfig
config BR2_PACKAGE_PPP2I4L
	bool "ppp2i4l"
	help
	  This program allows to use pppd with ISDN4Linux devices. Use
	    pty "exec /usr/sbin/ppp2i4l /dev/ippp0 ippp0"
	  or similar in your pppd's configuration file.
```

## src/packages/src/src/fbr/buildroot/package/pppdmpplugin/Config.in
```kconfig
config BR2_PACKAGE_PPPDMPPLUGIN
	bool "pppdmpplugin"
	help
	  This plugin calls /etc/ppp/mpslave-up whenever a MP slave link goes
	  online.
```

## src/packages/src/src/fbr/buildroot/package/reaver-wps/Config.in
```kconfig
config BR2_PACKAGE_REAVER_WPS
	bool "reaver-wps"
	select BR2_PACKAGE_SQLITE
	help
	  Reaver performs a brute force attack against an access point's WiFi
	  Protected Setup pin number. Once the WPS pin is found, the WPA PSK
	  can be recovered and alternately the AP's wireless settings can be 
	  reconfigured.
```

## src/packages/src/src/fbr/buildroot/package/rtl8192u-firmware/Config.in
```kconfig
config BR2_PACKAGE_RTL8192U_FIRMWARE
	bool "rtl8192u-firmware"
	help
	  Firmware for RealTel 8192U ethernet driver
```

## src/packages/src/src/fbr/buildroot/package/rtpengine/Config.in
```kconfig
config BR2_PACKAGE_RTPENGINE
	bool "rtpengine"
	depends on BR2_TOOLCHAIN_HAS_THREADS # libglib2 libxmlrpc
	depends on BR2_USE_WCHAR # libglib2
	depends on BR2_USE_MMU # libglib2
	select BR2_PACKAGE_LIBGLIB2
	select BR2_PACKAGE_PCRE
	select BR2_PACKAGE_LIBXMLRPC
	help
	  SIP proxy module for kamailio, previously known as mediaproxy-ng (SDP Proxy)

comment "rtpengine needs a toolchain w/ wchar, threads"
	depends on BR2_USE_MMU
	depends on !BR2_USE_WCHAR || !BR2_TOOLCHAIN_HAS_THREADS
```

## src/packages/src/src/fbr/buildroot/package/serdisplib/Config.in
```kconfig
config BR2_PACKAGE_SERDISPLIB
	bool "serdisplib"
	select BR2_PACKAGE_LIBUSB_COMPAT
	select BR2_PACKAGE_GD
	help
	  This is a library with support for certain serial and parallel
	  lc-displays connected to the parallel port (and also serial port with
	  i2c-displays). Some USB-displays are supported since version 1.97.x.
```

## src/packages/src/src/fbr/buildroot/package/sff2misc/Config.in
```kconfig
config BR2_PACKAGE_SFF2MISC
	bool "sff2misc"
	help
	  A converter from StructuredFaxFormat to other file formats (PBM,
	  PostScript, JPEG).
```

## src/packages/src/src/fbr/buildroot/package/sfftools/Config.in
```kconfig
config BR2_PACKAGE_SFFTOOLS
	bool "sfftools"
	select BR2_PACKAGE_TIFF
	select BR2_PACKAGE_LIBJPEG
	help
		The SFF tools allow you to deal with group 3 fax documents that are
		stored in the "Structured Fax File" (SFF) format that is produced by
		most ISDN devices that adhere to the CAPI specification
		(see http://www.capi.org).
```

## src/packages/src/src/fbr/buildroot/package/smstools/Config.in
```kconfig
config BR2_PACKAGE_SMSTOOLS
	bool "smstools"
	help
	  The SMS Server Tools send and receive short messages through GSM
	  modems or mobile phones.
```

## src/packages/src/src/fbr/buildroot/package/srv868/Config.in
```kconfig
config BR2_PACKAGE_SRV868
	bool "srv868"
	help
	  Fli4l-specific utility: Implements a RFC 868 time server.
```

## src/packages/src/src/fbr/buildroot/package/ss5/Config.in
```kconfig
config BR2_PACKAGE_SS5
	bool "ss5"
	help
	  SS5 is a socks server that implements the SOCKS v4 and v5 protocol.
```
