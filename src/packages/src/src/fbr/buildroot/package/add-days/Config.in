## src/packages/src/src/fbr/buildroot/package/add-days/Config.in
```kconfig
config BR2_PACKAGE_ADD_DAYS
	bool "add-days"
	help
	  Fli4l-specific utility: Adds a certain amount of days to the current
	  date.
```

## src/packages/src/src/fbr/buildroot/package/apcupsd/Config.in
```kconfig
config BR2_PACKAGE_APCUPSD
	bool "apcupsd"
	help
	  A tool to quickly ping N number of hosts to determine their
	  reachability.
```

## src/packages/src/src/fbr/buildroot/package/ath10k-firmware/Config.in
```kconfig
config BR2_PACKAGE_ATH10K_FIRMWARE
	bool "ath10k-firmware"
	help
	  This package provides firmware files for ath10k Kernel drivers.

	  https://github.com/kvalo/ath10k-firmware

if BR2_PACKAGE_ATH10K_FIRMWARE

config BR2_PACKAGE_ATH10K_FIRMWARE_QCA988X
	bool "Atheros QCA988X"
	help
	  Firmware files for the Atheros QCA988X family

config BR2_PACKAGE_ATH10K_FIRMWARE_QCA99X0
	bool "Atheros QCA99X0"
	help
	  Firmware files for the Atheros QCA99X0 family

endif
```

## src/packages/src/src/fbr/buildroot/package/ath_info/Config.in
```kconfig
config BR2_PACKAGE_ATH_INFO
	bool "ath_info"
	help
	  Allows to sets various PCI properties of Atheros devices.

	  http://madwifi-project.org/svn/ath_info/trunk/README
```

## src/packages/src/src/fbr/buildroot/package/atmel-firmware/Config.in
```kconfig
config BR2_PACKAGE_ATMEL_FIRMWARE
	bool "atmel-firmware"
	help
	  Firmware for atmel based wifi devices.
```

## src/packages/src/src/fbr/buildroot/package/avm-b1-firmware/Config.in
```kconfig
config BR2_PACKAGE_AVM_B1_FIRMWARE
	bool "avm-b1-firmware"
	help
	  Firmware for AVM B1 active ISDN cards
```

## src/packages/src/src/fbr/buildroot/package/avm-fcdsl-firmware/Config.in
```kconfig
config BR2_PACKAGE_AVM_FCDSL_FIRMWARE
	bool "avm-fcdsl-firmware"
	help
	  This package provides firmware files for AVM Fritz!card DSL adapters
```

## src/packages/src/src/fbr/buildroot/package/avm-fcdsl2-firmware/Config.in
```kconfig
config BR2_PACKAGE_AVM_FCDSL2_FIRMWARE
	bool "avm-fcdsl2-firmware"
	help
	  This package provides firmware files for AVM Fritz!card DSL v2 adapters
```

## src/packages/src/src/fbr/buildroot/package/avm-fcdslsl-firmware/Config.in
```kconfig
config BR2_PACKAGE_AVM_FCDSLSL_FIRMWARE
	bool "avm-fcdslsl-firmware"
	help
	  This package provides firmware files for AVM Fritz!card DSL SL adapters
```

## src/packages/src/src/fbr/buildroot/package/avm-fcdslslusb-firmware/Config.in
```kconfig
config BR2_PACKAGE_AVM_FCDSLSLUSB_FIRMWARE
	bool "avm-fcdslslusb-firmware"
	help
	  This package provides firmware files for AVM Fritz!card DSL SL USB adapters
```

## src/packages/src/src/fbr/buildroot/package/avm-fcdslusb-firmware/Config.in
```kconfig
config BR2_PACKAGE_AVM_FCDSLUSB_FIRMWARE
	bool "avm-fcdslusb-firmware"
	help
	  This package provides firmware files for AVM Fritz!card DSL USB adapters
	  version 1 and 2
```

## src/packages/src/src/fbr/buildroot/package/avm-fcusb2-firmware/Config.in
```kconfig
config BR2_PACKAGE_AVM_FCUSB2_FIRMWARE
	bool "avm-fcusb2-firmware"
	help
	  This package provides firmware files for AVM Fritz!USB v2 adapters
```

## src/packages/src/src/fbr/buildroot/package/avmfritz/Config.in
```kconfig
config BR2_PACKAGE_AVMFRITZ
	bool "avmfritz"
	depends on BR2_LINUX_KERNEL
	depends on BR2_i386 || BR2_x86_64
	help
	  Provides Linux kernel drivers for the AVM FRITZ! ISDN and DSL
	  adapters.

comment "avmfritz requires a Linux kernel to be built"
	depends on !BR2_LINUX_KERNEL

if BR2_PACKAGE_AVMFRITZ
menu "AVM FRITZ!Card drivers"

if BR2_i386
source "package/avmfritz/km_fritzcapi/Config.in"
endif
if BR2_x86_64
source "package/avmfritz/km_fritzcapi_x86_64/Config.in"
endif

if BR2_PACKAGE_KM_FRITZCAPI || BR2_PACKAGE_KM_FRITZCAPI_X86_64
menu "AVM FRITZ!Card ISDN drivers"
source "package/avmfritz/fcclassic/Config.in"
source "package/avmfritz/fcpnp/Config.in"
source "package/avmfritz/fcpci/Config.in"
source "package/avmfritz/fcpcmcia/Config.in"
source "package/avmfritz/fcusb/Config.in"
source "package/avmfritz/fcusb2/Config.in"
source "package/avmfritz/fxusb/Config.in"
endmenu
endif

if BR2_i386
source "package/avmfritz/km_fcdsl/Config.in"
endif
if BR2_x86_64
source "package/avmfritz/km_fcdsl_x86_64/Config.in"
endif

if BR2_PACKAGE_KM_FCDSL || BR2_PACKAGE_KM_FCDSL_X86_64
menu "AVM FRITZ!Card DSL drivers"
source "package/avmfritz/fcdsl/Config.in"
source "package/avmfritz/fcdsl2/Config.in"
source "package/avmfritz/fcdslsl/Config.in"
source "package/avmfritz/fcdslusb/Config.in"
source "package/avmfritz/fcdslusb2/Config.in"
source "package/avmfritz/fcdslslusb/Config.in"
endmenu
endif

endmenu
endif
```

## src/packages/src/src/fbr/buildroot/package/avmfritz/fcclassic/Config.in
```kconfig
config BR2_PACKAGE_FCCLASSIC
	bool "fcclassic"
	depends on BR2_PACKAGE_KM_FRITZCAPI
	help
	  Kernel module for the AVM FRITZ!Card Classic.
```

## src/packages/src/src/fbr/buildroot/package/avmfritz/fcdsl/Config.in
```kconfig
config BR2_PACKAGE_FCDSL
	bool "fcdsl"
	depends on BR2_PACKAGE_KM_FCDSL
	help
	  Kernel module for the AVM FRITZ!Card DSL PCI.
```

## src/packages/src/src/fbr/buildroot/package/avmfritz/fcdslusb/Config.in
```kconfig
config BR2_PACKAGE_FCDSLUSB
	bool "fcdslusb"
	depends on BR2_PACKAGE_KM_FCDSL || BR2_PACKAGE_KM_FCDSL_X86_64
	help
	  Kernel module for the AVM FRITZ!Card DSL USB.
```

## src/packages/src/src/fbr/buildroot/package/avmfritz/fcdslusb2/Config.in
```kconfig
config BR2_PACKAGE_FCDSLUSB2
	bool "fcdslusb2"
	depends on BR2_PACKAGE_KM_FCDSL || BR2_PACKAGE_KM_FCDSL_X86_64
	help
	  Kernel module for the AVM FRITZ!Card DSL USB V2.
```

## src/packages/src/src/fbr/buildroot/package/avmfritz/fcpci/Config.in
```kconfig
config BR2_PACKAGE_FCPCI
	bool "fcpci"
	depends on BR2_PACKAGE_KM_FRITZCAPI || BR2_PACKAGE_KM_FRITZCAPI_X86_64
	help
	  Kernel module for the AVM FRITZ!Card PCI.
```

## src/packages/src/src/fbr/buildroot/package/avmfritz/fcpcmcia/Config.in
```kconfig
config BR2_PACKAGE_FCPCMCIA
	bool "fcpcmcia"
	depends on BR2_PACKAGE_KM_FRITZCAPI || BR2_PACKAGE_KM_FRITZCAPI_X86_64
	help
	  Kernel module for the AVM FRITZ!Card PCMCIA.
```

## src/packages/src/src/fbr/buildroot/package/avmfritz/fcpnp/Config.in
```kconfig
config BR2_PACKAGE_FCPNP
	bool "fcpnp"
	depends on BR2_PACKAGE_KM_FRITZCAPI
	help
	  Kernel module for the AVM FRITZ!Card PnP.
```

## src/packages/src/src/fbr/buildroot/package/avmfritz/fcusb/Config.in
```kconfig
config BR2_PACKAGE_FCUSB
	bool "fcusb"
	depends on BR2_PACKAGE_KM_FRITZCAPI
	help
	  Kernel module for the AVM FRITZ!Card USB.
```

## src/packages/src/src/fbr/buildroot/package/avmfritz/fcusb2/Config.in
```kconfig
config BR2_PACKAGE_FCUSB2
	bool "fcusb2"
	depends on BR2_PACKAGE_KM_FRITZCAPI || BR2_PACKAGE_KM_FRITZCAPI_X86_64
	help
	  Kernel module for the AVM FRITZ!Card USB V2.
```

## src/packages/src/src/fbr/buildroot/package/avmfritz/fxusb/Config.in
```kconfig
config BR2_PACKAGE_FXUSB
	bool "fxusb"
	depends on BR2_PACKAGE_KM_FRITZCAPI
	help
	  Kernel module for the AVM FRITZ!X USB.
```

## src/packages/src/src/fbr/buildroot/package/avmfritz/km_fcdsl/Config.in
```kconfig
config BR2_PACKAGE_KM_FCDSL
	bool "km_fcdsl"
	depends on BR2_i386
	help
	  Provides common IA-32 driver sources for the AVM FRITZ!DSL
	  adapters.

comment "km_fcdsl requires a Linux kernel to be built"
	depends on !BR2_LINUX_KERNEL
```

## src/packages/src/src/fbr/buildroot/package/avmfritz/km_fcdsl_x86_64/Config.in
```kconfig
config BR2_PACKAGE_KM_FCDSL_X86_64
	bool "km_fcdsl_x86_64"
	depends on BR2_x86_64
	help
	  Provides common x86-64 driver sources for the AVM FRITZ!DSL
	  adapters.

comment "km_fcdsl_x86_64 requires a Linux kernel to be built"
	depends on !BR2_LINUX_KERNEL
```
