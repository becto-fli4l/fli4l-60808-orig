## src/packages/src/src/fbr/buildroot/package/stuntman/Config.in
```kconfig
config BR2_PACKAGE_STUNTMAN
	bool "stuntman"
	help
         STUNTMAN is an open source implementation of the STUN
         protocol (Session Traversal Utilities for NAT) as specified
         in RFCs 5389, 5769, and 5780. It also includes backwards
         compatibility for RFC 3489. Source code distribution includes
         a high performance STUN server, a client application, and a
         set of code libraries for implementing a STUN client within
         an application.
```

## src/packages/src/src/fbr/buildroot/package/swconfig/Config.in
```kconfig
config BR2_PACKAGE_SWCONFIG
	bool "swconfig"
	depends on !BR2_STATIC_LIBS # libuci
        depends on BR2_TOOLCHAIN_HAS_THREADS # libnl
	select BR2_PACKAGE_LIBUCI
	select BR2_PACKAGE_LIBUBOX
        select BR2_PACKAGE_LIBNL
	help
	  OpenWRT-specific package for switch configuration.
```

## src/packages/src/src/fbr/buildroot/package/telmond/Config.in
```kconfig
config BR2_PACKAGE_TELMOND
	bool "telmond"
	help
	  Fli4l-specific utility: Captures incoming ISDN calls and logs them to
	  a file.
```

## src/packages/src/src/fbr/buildroot/package/transproxy/Config.in
```kconfig
config BR2_PACKAGE_TRANSPROXY
	bool "transproxy"
	help
	  transproxy is used in conjunction with the Linux transparent proxy
	  feature (ipfwadm, ipchains, iptables), to transparently proxy HTTP
	  requests.
```

## src/packages/src/src/fbr/buildroot/package/ucarp/Config.in
```kconfig
config BR2_PACKAGE_UCARP
	bool "ucarp"
	help
	  UCARP allows a couple of hosts to share common virtual IP addresses
	  in order to provide automatic failover. It is a portable userland
	  implementation of the secure and patent-free Common Address
	  Redundancy Protocol (CARP, OpenBSD's alternative to the
	  patents-bloated VRRP).
```

## src/packages/src/src/fbr/buildroot/package/usbip/Config.in
```kconfig
config BR2_PACKAGE_USBIP
	bool "usbip"
	select BR2_PACKAGE_LIBGLIB2
	select BR2_PACKAGE_LIBSYSFS
	help
	  Devices exported by USB/IP servers can be listed, attached and
	  detached using this program.
```

## src/packages/src/src/fbr/buildroot/package/watchdogd/Config.in
```kconfig
config BR2_PACKAGE_WATCHDOGD
	bool "watchdogd"
	help
	  Simple watchdog daemon with signal handling and syslog messaging. You
	  can configure the trigger interval, the device name, and the reset
	  timeout. Not every watchdog driver allows the programming of the
	  reset timeout so please be careful with this option.
```

## src/packages/src/src/fbr/buildroot/package/yaps/Config.in
```kconfig
config BR2_PACKAGE_YAPS
	bool "yaps"
	help
	  This software is primary designed to send message to so called pager
	  devices including cellular phones which are able to receive textual
	  messages (sometimes called SMS, short message system/service.)
```

## src/packages/src/src/fbr/buildroot/package/ytree/Config.in
```kconfig
config BR2_PACKAGE_YTREE
	bool "ytree"
	help
	  ytree is a DOS-XTREE(tm) similar file manager.
```

## src/packages/src/src/fbr/buildroot/package/zd1201-firmware/Config.in
```kconfig
config BR2_PACKAGE_ZD1201_FIRMWARE
	bool "zd1201-firmware"
	help
	  Firmware for the ZyDAS ZD1201 based wifi devices.
```
