## src/packages/src/src/fbr/buildroot/package/avmfritz/km_fritzcapi/Config.in
```kconfig
config BR2_PACKAGE_KM_FRITZCAPI
	bool "km_fritzcapi"
	depends on BR2_i386
	help
	  Provides common IA-32 driver sources for the AVM FRITZ!ISDN
	  adapters.

comment "km_fritzcapi requires a Linux kernel to be built"
	depends on !BR2_LINUX_KERNEL
```

## src/packages/src/src/fbr/buildroot/package/b2d/Config.in
```kconfig
config BR2_PACKAGE_B2D
	bool "b2d"
	help
	  Fli4l-specific utility: Converts an input character to its ASCII
	  code point (e.g. input 'A' results in '65'). Only the first character
	  is read, multibyte (e.g. non-ASCII) characters are not supported.
```

## src/packages/src/src/fbr/buildroot/package/b43legacy-firmware/Config.in
```kconfig
config BR2_PACKAGE_B43LEGACY_FIRMWARE
	bool "b43legacy-firmware"
	help
	  Firmware for the Broadcom Wifi devices supported by the b43 legacy
	  kernel driver.
```

## src/packages/src/src/fbr/buildroot/package/concurrentlua/Config.in
```kconfig
config BR2_PACKAGE_CONCURRENTLUA
	bool "concurrentlua"
	depends on BR2_PACKAGE_COPAS
	help
	  ConcurrentLua is a system that implements a concurrency model for the Lua
	  programming language. It is based on the share-nothing asynchronous
	  message-passing model that is employed in the Erlang programming language.

	  ConcurrentLua extends Lua's coroutines with message-passing primitives, in
	  order to support concurrent programming. Distributed programming is supported
	  transparently with the same message-passing primitives.

	  ConcurrentLua is implemented as a collection of Lua modules that can be
	  loaded by any Lua program. Most of the code is written in Lua itself, with
	  minor parts written in C.

	  https://github.com/lefcha/concurrentlua
```

## src/packages/src/src/fbr/buildroot/package/cpanel/Config.in
```kconfig
config BR2_PACKAGE_CPANEL
	bool "cpanel"
	help
	  Fli4l-specific utility: Remote control program over the serial port.
```

## src/packages/src/src/fbr/buildroot/package/cron/Config.in
```kconfig
config BR2_PACKAGE_CRON
	bool "cron"
	help
	  Cron allows to schedule jobs (commands or shell scripts) to run
	  periodically at certain times or dates. 
```

## src/packages/src/src/fbr/buildroot/package/dpflib/Config.in
```kconfig
config BR2_PACKAGE_DPFLIB
	bool "dpflib"
	help
	  Some tools to hack digital picture frames (DPFs) based on AX206.
```

## src/packages/src/src/fbr/buildroot/package/dsltool/Config.in
```kconfig
config BR2_PACKAGE_DSLTOOL
	bool "dsltool"
	depends on BR2_PACKAGE_CAIRO
	depends on BR2_PACKAGE_COLLECTD
	depends on BR2_PACKAGE_PANGO
	select BR2_PACKAGE_LIBTELNET
	select BR2_PACKAGE_LIBXML2
	select BR2_PACKAGE_ZLIB
```

## src/packages/src/src/fbr/buildroot/package/eagle-usb/Config.in
```kconfig
config BR2_PACKAGE_EAGLE_USB
	bool "eagle-usb"
	help
	  This driver is used to manage the USB device for ADSL USB modems
	  based on the chipset Eagle 8051 by Analog, as the modem ADSL USB
	  Sagem F@st 800, Fast 908, Comtrend CT-351, USRobotics SureConnect
	  9000.
```

## src/packages/src/src/fbr/buildroot/package/extra-gpio/Config.in
```kconfig
config BR2_PACKAGE_EXTRA_GPIO
	bool "extra-gpio"
	depends on BR2_LINUX_KERNEL
	help
	  extra gpio drivers

comment "extra-gpio requires a Linux kernel to be built"
	depends on !BR2_LINUX_KERNEL
```

## src/packages/src/src/fbr/buildroot/package/fdpass/Config.in
```kconfig
config BR2_PACKAGE_FDPASS
	bool "fdpass"
	help
	  Fli4l-specific package: Allows to pass file descriptors between
	  sibling processes.
```

## src/packages/src/src/fbr/buildroot/package/generic-leds/Config.in
```kconfig
config BR2_PACKAGE_GENERIC_LEDS
	bool "generic-leds"
	depends on BR2_LINUX_KERNEL
	help
	  drivers for LED's

comment "generic-leds requires a Linux kernel to be built"
	depends on !BR2_LINUX_KERNEL
```

## src/packages/src/src/fbr/buildroot/package/gethostname/Config.in
```kconfig
config BR2_PACKAGE_GETHOSTNAME
	bool "gethostname"
	help
	  Fli4l-specific package: Determines the host name for an IPv4 address.
```

## src/packages/src/src/fbr/buildroot/package/gobi_loader/Config.in
```kconfig
config BR2_PACKAGE_GOBI_LOADER
	bool "gobi_loader"
	help
	  gobi_loader is a firmware loader for Qualcomm Gobi USB chipsets.
	  These devices appear in an uninitialised state when power is applied
	  and require firmware to be loaded before they can be used as modems.

	  http://www.codon.org.uk/~mjg59/gobi_loader/
```

## src/packages/src/src/fbr/buildroot/package/gogoc/Config.in
```kconfig
config BR2_PACKAGE_GOGOC
	bool "gogoc"
	help
	  The gogoCLIENT is used on the host computer to connect to a tunnel
	  broker using the TSP protocol and to get the information for its
	  tunnel. TSP is a control protocol used to establish and maintain
	  static tunnels.
```

## src/packages/src/src/fbr/buildroot/package/hconv/Config.in
```kconfig
config BR2_PACKAGE_HCONV
	bool "hconv"
	help
	  Fli4l-specific utility: Allows (a) to convert Epoch seconds to a
	  human-readable time point and (b) to convert a number of bytes to
	  a human-readable value, expressed in kiB, MiB, or GiB (similar to
	  bytes2read).
```

## src/packages/src/src/fbr/buildroot/package/horst/Config.in
```kconfig
config BR2_PACKAGE_HORST
	bool "horst"
	help
	  "horst" is a scanning and analysis tool for IEEE802.11 wireless
	  ad-hoc (IBSS) networks and the OLSR mesh routing protocol. it can be
	  used discover the best OLSR nodes in the neighbourhood, to optimize
	  antenna positions and to discover problems in the mesh network.
```

## src/packages/src/src/fbr/buildroot/package/hwclock/Config.in
```kconfig
config BR2_PACKAGE_HWCLOCK
	bool "hwclock"
	help
	  hwclock is a tool for accessing the Hardware Clock. You can display
	  the current time, set the Hardware Clock to a specified time, set the
	  Hardware Clock to the System Time, and set the System Time from the
	  Hardware Clock.
```

## src/packages/src/src/fbr/buildroot/package/hwsuppd/Config.in
```kconfig
config BR2_PACKAGE_HWSUPPD
	bool "hwsuppd"
	depends on BR2_PACKAGE_LIBEVDEV
	help
	  Fli4l-specific utility: Controls various aspects of devices on
	  embedded platforms.
```

## src/packages/src/src/fbr/buildroot/package/i4l-firmware/Config.in
```kconfig
config BR2_PACKAGE_I4L_FIRMWARE
	bool "i4l-firmware"
	help
	  This package provides various firmware files from the ISDN4linux
	  repository (e.g. ICN).

if BR2_PACKAGE_I4L_FIRMWARE

menu "ICN firmware"

config BR2_PACKAGE_I4L_FIRMWARE_ICN2B
   bool "ICN 2B"
   help
     Firmware for ICN 2B ISDN cards

endmenu

endif
```

## src/packages/src/src/fbr/buildroot/package/img-cdemul/Config.in
```kconfig
config BR2_PACKAGE_IMG_CDEMUL
	bool "img-cdemul"
	depends on BR2_i386 || BR2_x86_64
	help
	  Fli4l-specific package: Provides a floppy image for booting fli4l
	  from CD.
```

## src/packages/src/src/fbr/buildroot/package/imonc/Config.in
```kconfig
config BR2_PACKAGE_IMONC
	bool "imonc"
	help
	  Fli4l-specific utility: Communicates with imond by using a command
	  line interface.
```

## src/packages/src/src/fbr/buildroot/package/imond-stat/Config.in
```kconfig
config BR2_PACKAGE_IMOND_STAT
	bool "imond-stat"
	help
	  Fli4l-specific utility: Communicates with imond by using internal
	  command protocol.
```

## src/packages/src/src/fbr/buildroot/package/imond/Config.in
```kconfig
config BR2_PACKAGE_IMOND
	bool "imond"
	help
	  Fli4l-specific utility: Monitors and controls ISDN and DSL
	  connections.
```

## src/packages/src/src/fbr/buildroot/package/improxy/Config.in
```kconfig
config BR2_PACKAGE_IMPROXY
	bool "improxy"
	help
	  IGMP/MLD Proxy which supports IGMPv3 and
	  MLDv2 completely.

	  https://github.com/haibbo/improxy
```
