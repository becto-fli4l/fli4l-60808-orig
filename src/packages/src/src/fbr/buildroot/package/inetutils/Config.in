## src/packages/src/src/fbr/buildroot/package/inetutils/Config.in
```kconfig
config BR2_PACKAGE_INETUTILS
	bool "inetutils"
	help
	  This is a distribution of common networking utilities and servers.

	  For fli4l, only the ftp client is built.
```

## src/packages/src/src/fbr/buildroot/package/ipw2100-firmware/Config.in
```kconfig
config BR2_PACKAGE_IPW2100_FIRMWARE
	bool "ipw2100-firmware"
	help
	  Firmware for Intel PRO/Wireless 2100 devices
```

## src/packages/src/src/fbr/buildroot/package/ipw2200-firmware/Config.in
```kconfig
config BR2_PACKAGE_IPW2200_FIRMWARE
	bool "ipw2200-firmware"
	help
	  Firmware for Intel PRO/Wireless 2200 and 2915 devices
```

## src/packages/src/src/fbr/buildroot/package/isapnptools/Config.in
```kconfig
config BR2_PACKAGE_ISAPNPTOOLS
	bool "isapnptools"
	help
	  These programs allow ISA Plug-And-Play devices to be configured on a
	  Linux machine.
```

## src/packages/src/src/fbr/buildroot/package/isdn-firmware/Config.in
```kconfig
config BR2_PACKAGE_ISDN_FIRMWARE
	bool "isdn-firmware"
	help
	  ISAR.bin firmware ISDN cards
```

## src/packages/src/src/fbr/buildroot/package/isdn_rate/Config.in
```kconfig
config BR2_PACKAGE_ISDN_RATE
	bool "isdn_rate"
	help
	  Fli4l-specific utility: Shows ISDN rates and other fli4l stuff on
	  LCD.
```

## src/packages/src/src/fbr/buildroot/package/isdnutils/Config.in
```kconfig
menuconfig BR2_PACKAGE_ISDNUTILS
	bool "isdnutils"

if BR2_PACKAGE_ISDNUTILS
source "package/isdnutils/actctrl/Config.in"
source "package/isdnutils/avmcapictrl/Config.in"
source "package/isdnutils/capifax/Config.in"
source "package/isdnutils/capiinfo/Config.in"
source "package/isdnutils/capiinit/Config.in"
source "package/isdnutils/divertctrl/Config.in"
source "package/isdnutils/eicon/Config.in"
source "package/isdnutils/hisaxctrl/Config.in"
source "package/isdnutils/icnctrl/Config.in"
source "package/isdnutils/imontty/Config.in"
source "package/isdnutils/ipppd/Config.in"
source "package/isdnutils/isdnctrl/Config.in"
source "package/isdnutils/libcapi20/Config.in"
source "package/isdnutils/libisdn/Config.in"
source "package/isdnutils/pppdcapiplugin/Config.in"
source "package/isdnutils/rcapid/Config.in"
source "package/isdnutils/vbox/Config.in"
endif
```

## src/packages/src/src/fbr/buildroot/package/isdnutils/pppdcapiplugin/Config.in
```kconfig
config BR2_PACKAGE_PPPDCAPIPLUGIN
	bool "pppdcapiplugin"
	depends on BR2_PACKAGE_PPPD
	select BR2_PACKAGE_LIBCAPI20
```

## src/packages/src/src/fbr/buildroot/package/isdnutils/vbox/Config.in
```kconfig
config BR2_PACKAGE_VBOX
	bool "vbox"
	select BR2_PACKAGE_TCL
	select BR2_PACKAGE_NCURSES
```

## src/packages/src/src/fbr/buildroot/package/iwleeprom/Config.in
```kconfig
config BR2_PACKAGE_IWLEEPROM
	bool "iwleeprom"
	help
	  Intel/Atheros EEPROM utility, to be used eg. to change regdomain settings
	  on WLAN cards (see also https://code.google.com/p/iwleeprom)
	 
```
