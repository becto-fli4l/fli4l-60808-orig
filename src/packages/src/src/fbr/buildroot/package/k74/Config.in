## src/packages/src/src/fbr/buildroot/package/lrandom/Config.in
```kconfig
config BR2_PACKAGE_LRANDOM
	bool "lrandom"
	depends on BR2_PACKAGE_HAS_LUAINTERPRETER
	depends on !BR2_PACKAGE_LUA_5_3
	help
	  A library for generating random numbers
	  based on the Mersenne Twister

	  http://www.tecgraf.puc-rio.br/~lhf/ftp/lua/#lrandom

comment "lrandom needs a Lua 5.1/5.2 interpreter"
	depends on BR2_PACKAGE_LUA_5_3
```

## src/packages/src/src/fbr/buildroot/package/lua-middleclass/Config.in
```kconfig
config BR2_PACKAGE_LUA_MIDDLECLASS
	bool "lua-middleclass"
	help
	  Middleclass is an object-oriented library for Lua.

	  https://github.com/kikito/middleclass
```

## src/packages/src/src/fbr/buildroot/package/luacrypto/Config.in
```kconfig
config BR2_PACKAGE_LUACRYPTO
	bool "luacrypto"
	depends on !BR2_PACKAGE_LUA_5_3
	select BR2_PACKAGE_OPENSSL
	help
	  LuaCrypto provides a Lua frontend to the OpenSSL cryptographic
	  library.
	  The OpenSSL features that are currently exposed are digests
	  (MD5, SHA-1, HMAC, and more) and crypto-grade random number
	  generators communication.

	  http://luacrypto.luaforge.net

comment "luacrypto needs a Lua 5.1/5.2 interpreter"
	depends on BR2_PACKAGE_LUA_5_3
```

## src/packages/src/src/fbr/buildroot/package/metalog/Config.in
```kconfig
config BR2_PACKAGE_METALOG
	bool "metalog"
	help
	  Metalog is a modern replacement for syslogd and klogd. The logged
	  messages can be dispatched according to their facility, urgency,
	  program name and/or Perl-compatible regular expressions. Log files
	  can be automatically rotated when they exceed a certain size or age.
	  External shell scripts (e.g., mail) can be launched when specific
	  patterns are found.

	  Metalog is simple to configure, accepts unlimited number of rules and
	  has (switchable) memory bufferization for maximal performance.
```

## src/packages/src/src/fbr/buildroot/package/mgetty/Config.in
```kconfig
config BR2_PACKAGE_MGETTY
	bool "mgetty"
	help
	  This package contains programs to send and receive faxes in a unix
	  environment using a class 2 faxmodem.
```

## src/packages/src/src/fbr/buildroot/package/mini-login/Config.in
```kconfig
config BR2_PACKAGE_MINI_LOGIN
	bool "mini-login"
	help
	  Fli4l-specific utility: Minimalistic login program.
```

## src/packages/src/src/fbr/buildroot/package/mini_httpd/Config.in
```kconfig
config BR2_PACKAGE_MINI_HTTPD
	bool "mini_httpd"
	help
	  mini_httpd is a small HTTP server.  Its performance is not great, but
	  for low or medium traffic sites it's quite adequate. It implements
	  all the basic features of an HTTP server. It can also be configured
	  to do SSL/HTTPS.
```

## src/packages/src/src/fbr/buildroot/package/misdnuser/Config.in
```kconfig
config BR2_PACKAGE_MISDNUSER
	bool "misdnuser"
	help
	  This package contain the libmisdn library and some utilities for the
	  mISDN version 2 Linux ISDN stack.

if BR2_PACKAGE_MISDNUSER

config BR2_PACKAGE_MISDNUSER_CAPI
        bool "capi"
        default y
        select BR2_PACKAGE_LIBCAPI20
        help
	  This enables CAPI support for ISDN cards using the mISDN driver.

config BR2_PACKAGE_MISDNUSER_SOFTDSP
        bool "softdsp"
        default y
        select BR2_PACKAGE_LIBSPANDSP
        help
	  This enables SoftDSP support for analog FAX.

endif
```

## src/packages/src/src/fbr/buildroot/package/mkfli4l-tools/Config.in
```kconfig
config BR2_PACKAGE_MKFLI4L_TOOLS
	bool "mkfli4l-tools"
	help
	  Fli4l-specific package: Parses and checks a fli4l configuration and
	  builds a fli4l installation image based on it.
```

## src/packages/src/src/fbr/buildroot/package/mo2ipc_a78/Config.in
```kconfig
config BR2_PACKAGE_MO2IPC_A78
	bool "mo2ipc_a78"
	depends on BR2_i386 || BR2_x86_64
	help
	  Fli4l-specific utility: Converts MATRIX-ORBITAL output from isdn_rate
	  to IPC A78.
```

## src/packages/src/src/fbr/buildroot/package/mom_netlink/Config.in
```kconfig
config BR2_PACKAGE_MOM_NETLINK
	bool "mom_netlink"
	help
	  Fli4l-specific utility: Propagates network-related netlink events to
	  event-driven services implemented by shell scripts.
```

## src/packages/src/src/fbr/buildroot/package/muninlite/Config.in
```kconfig
config BR2_PACKAGE_MUNINLITE
        bool "muninlite"
      help
	  Muninlite is a smal munin-node for the munin project.
	  Munin:
	    http://munin-monitoring.org
	  Muninlite
	    http://sourceforge.net/projects/muninlite
```

## src/packages/src/src/fbr/buildroot/package/nc/Config.in
```kconfig
config BR2_PACKAGE_NC
	bool "nc"
	help
	  Netcat is a simple Unix utility which reads and writes data across
	  network connections, using TCP or UDP protocol.
```

## src/packages/src/src/fbr/buildroot/package/netcalc/Config.in
```kconfig
config BR2_PACKAGE_NETCALC
	bool "netcalc"
	help
	  Fli4l-specific utility: Performs various calculations on IP addresses.
```
