## src/packages/src/src/fbr/buildroot/package/k74/Config.in
```kconfig
config BR2_PACKAGE_K74
	bool "k74"
	help
	  kitsrus.com kit 74 parallel port relay driver.
```

## src/packages/src/src/fbr/buildroot/package/kamailio/Config.in
```kconfig
config BR2_PACKAGE_KAMAILIO
	bool "kamailio"
	select BR2_PACKAGE_EXPAT
	select BR2_PACKAGE_IPTABLES
	select BR2_PACKAGE_LIBCONFUSE
	select BR2_PACKAGE_LIBCURL
	select BR2_PACKAGE_LIBXML2
	select BR2_PACKAGE_PCRE
	help
	  sip proxy / router
```

## src/packages/src/src/fbr/buildroot/package/knot/Config.in
```kconfig
config BR2_PACKAGE_KNOT
	depends on BR2_PACKAGE_LIBURCU_ARCH_SUPPORTS
	depends on BR2_TOOLCHAIN_HAS_THREADS
	select BR2_PACKAGE_LIBURCU
	bool "knot (dns server)"
```

## src/packages/src/src/fbr/buildroot/package/lcd4linux/Config.in
```kconfig
config BR2_PACKAGE_LCD4LINUX
	bool "lcd4linux"
	select BR2_PACKAGE_SERDISPLIB
	select BR2_PACKAGE_GD
	select BR2_PACKAGE_JPEG
	select BR2_PACKAGE_LIBUSB
	select BR2_PACKAGE_DPFLIB
	select BR2_PACKAGE_NCURSES
	help
	  LCD4Linux is a small program that grabs information from the kernel
	  and some subsystems and displays it on an external liquid crystal
	  display.
```

## src/packages/src/src/fbr/buildroot/package/lcdhitachi/Config.in
```kconfig
config BR2_PACKAGE_LCDHITACHI
	bool "lcdhitachi"
	depends on BR2_LINUX_KERNEL
	help
	  LCD Panel driver for Hitachi controlled LCD display panels connected to
	  the parallel port (and many compatible modules).

	  http://www.unix-ag.uni-siegen.de/~nils/lcd.html

comment "lcdhitachi requires a Linux kernel to be built"
	depends on !BR2_LINUX_KERNEL
```

## src/packages/src/src/fbr/buildroot/package/libspandsp/Config.in
```kconfig
config BR2_PACKAGE_LIBSPANDSP
	bool "libspandsp"
	select BR2_PACKAGE_TIFF
	help
	  Spandsp is a library of many DSP functions for telephony.
	  These range from simple modules, such as DTMF detection, to a
	  complete software FAX machine.

	  http://www.soft-switch.org
```

## src/packages/src/src/fbr/buildroot/package/libtelnet/Config.in
```kconfig
config BR2_PACKAGE_LIBTELNET
	bool "libtelnet"
	depends on BR2_PACKAGE_ZLIB
	help
	  libtelnet provides safe and correct handling of the core TELNET
	  protocol. In addition to the base TELNET protocol, libtelnet also
	  implements the Q method of TELNET option negotiation.  libtelnet can
	  be used for writing servers, clients, or proxies.

	  http://github.com/seanmiddleditch/libtelnet
```
