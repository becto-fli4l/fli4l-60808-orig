## src/packages/src/src/fbr/buildroot/package/linux-firmware/Config.in
```kconfig
config BR2_PACKAGE_LINUX_FIRMWARE
	bool "linux-firmware"
	help
	  This package provides various binary firmware files (closed
	  binary blobs) for such devices like LAN, WLAN cards etc.

	  https://git.kernel.org/?p=linux/kernel/git/firmware/linux-firmware.git

if BR2_PACKAGE_LINUX_FIRMWARE

menu "Audio firmware"

config BR2_PACKAGE_LINUX_FIRMWARE_INTEL_SST_DSP
	bool "Intel SST DSP"
	help
	  Firmware files for Intel Baytrail SST DSP audio.

endmenu # Audio

menu "Video firmware"

config BR2_PACKAGE_LINUX_FIRMWARE_I915
	bool "Intel i915 video card firmware"
	help
	  Firmware files for the Intel i915 video cards.

config BR2_PACKAGE_LINUX_FIRMWARE_RADEON
	bool "AMD Radeon video card firmware"
	help
	  Firmware files for AMD Radeon video cards.

endmenu # Video

menu "Bluetooth firmware"

config BR2_PACKAGE_LINUX_FIRMWARE_IBT
	bool "Intel Wireless Bluetooth"
	help
	  Firmware files for Intel 3160/7260/7265/8260/8265 Wireless
	  bluetooth support.

config BR2_PACKAGE_LINUX_FIRMWARE_QUALCOMM_6174A_BT
	bool "Qualcomm Atheros Rome 6174A Bluetooth"
	help
	  Firmware files for QCA Rome 6174A bluetooth support.

endmenu # Bluetooth

menu "WiFi firmware"

config BR2_PACKAGE_LINUX_FIRMWARE_ATHEROS_5523
   bool "Atheros 5523"
   help
     Firmware files for the Atheros 5523 based USB WiFi adapters

config BR2_PACKAGE_LINUX_FIRMWARE_ATHEROS_6002
	bool "Atheros 6002"
	help
	  Firmware files for the Atheros AR6002 chip

config BR2_PACKAGE_LINUX_FIRMWARE_ATHEROS_6003
	bool "Atheros 6003"
	help
	  Firmware files for the Atheros AR6003 chip

config BR2_PACKAGE_LINUX_FIRMWARE_ATHEROS_6004
	bool "Atheros 6004"
	help
	  Firmware files for the Atheros AR6004 chip

config BR2_PACKAGE_LINUX_FIRMWARE_ATHEROS_7010
	bool "Atheros 7010"
	help
	  Firmware files for the Atheros 7010 module

config BR2_PACKAGE_LINUX_FIRMWARE_ATHEROS_9170
	bool "Atheros 9170"
	help
	  Firmware files for the Atheros 9170 module

config BR2_PACKAGE_LINUX_FIRMWARE_ATHEROS_9271
	bool "Atheros 9271"
	help
	  Firmware files for the Atheros 9271 module

config BR2_PACKAGE_LINUX_FIRMWARE_ATHEROS_QCA6174
	bool "Atheros QCA6174"
	help
	  Firmware files for the Atheros QCA6174 family

config BR2_PACKAGE_LINUX_FIRMWARE_ATHEROS_QCA9377
	bool "Atheros QCA9377"
	help
	  Firmware files for the Atheros QCA9377 family

config BR2_PACKAGE_LINUX_FIRMWARE_ATHEROS_QCA988X
	bool "Atheros QCA988X"
	help
	  Firmware files for the Atheros QCA988X family

config BR2_PACKAGE_LINUX_FIRMWARE_ATH9K_HTC
	bool "Atheros HTC based devices"
	help
	  Firmware files for Atheros 802.11n HTC based wireless devices

config BR2_PACKAGE_LINUX_FIRMWARE_ATHEROS_WIL6210
	bool "Atheros WIL6210"
	help
	  Firmware files for the Atheros WIL6210 family

config BR2_PACKAGE_LINUX_FIRMWARE_BRCM_BCM43XX
	bool "Broadcom BRCM bcm43xx"
	help
	  Firmware files for the Broadcom bcm43xx SoftMAC and FullMAC.

config BR2_PACKAGE_LINUX_FIRMWARE_BRCM_BCM43XXX
	bool "Broadcom BRCM bcm43xxx"
	help
	  Firmware files for the Broadcom bcm43xxx, SoftMAC and FullMAC.

config BR2_PACKAGE_LINUX_FIRMWARE_IWLWIFI_100
	bool "Intel iwlwifi 100"
	help
	  Firmware files for the Intel Wifi 100 devices supported by
	  the iwlwifi kernel driver.

config BR2_PACKAGE_LINUX_FIRMWARE_IWLWIFI_105
	bool "Intel iwlwifi 105"
	help
	  Firmware files for the Intel Wifi 105 devices supported by
	  the iwlwifi kernel driver.

config BR2_PACKAGE_LINUX_FIRMWARE_IWLWIFI_135
	bool "Intel iwlwifi 135"
	help
	  Firmware files for the Intel Wifi 135 devices supported by
	  the iwlwifi kernel driver.

config BR2_PACKAGE_LINUX_FIRMWARE_IWLWIFI_1000
	bool "Intel iwlwifi 1000"
	help
	  Firmware files for the Intel Wifi 1000 devices supported by
	  the iwlwifi kernel driver.

config BR2_PACKAGE_LINUX_FIRMWARE_IWLWIFI_2200
	bool "Intel iwlwifi 2200"
	help
	  Firmware files for the Intel Wifi 2200 devices supported by
	  the iwlwifi kernel driver.

config BR2_PACKAGE_LINUX_FIRMWARE_IWLWIFI_2230
	bool "Intel iwlwifi 2230"
	help
	  Firmware files for the Intel Wifi 2230 devices supported by
	  the iwlwifi kernel driver.

config BR2_PACKAGE_LINUX_FIRMWARE_IWLWIFI_3160
	bool "Intel iwlwifi 3160"
	help
	  Firmware files for the Intel Wifi 3160 devices supported by
	  the iwlwifi kernel driver.

config BR2_PACKAGE_LINUX_FIRMWARE_IWLWIFI_3168
	bool "Intel iwlwifi 3168"
	help
	  Firmware files for the Intel Wifi 3168 devices supported by
	  the iwlwifi kernel driver.

config BR2_PACKAGE_LINUX_FIRMWARE_IWLWIFI_3945
	bool "Intel iwlwifi 3945"
	help
	  Firmware files for the Intel Wifi 3945 devices supported by
	  the iwlwifi kernel driver.

config BR2_PACKAGE_LINUX_FIRMWARE_IWLWIFI_4965
	bool "Intel iwlwifi 4965"
	help
	  Firmware files for the Intel Wifi 4965 devices supported by
	  the iwlwifi kernel driver.

config BR2_PACKAGE_LINUX_FIRMWARE_IWLWIFI_5000
	bool "Intel iwlwifi 5000"
	help
	  Firmware files for the Intel Wifi 5000 devices supported by
	  the iwlwifi kernel driver.

config BR2_PACKAGE_LINUX_FIRMWARE_IWLWIFI_5150
	bool "Intel iwlwifi 5150"
	help
	  Firmware files for the Intel Wifi 5150 devices supported by
	  the iwlwifi kernel driver.

config BR2_PACKAGE_LINUX_FIRMWARE_IWLWIFI_6000
	bool "Intel iwlwifi 6000"
	help
	  Firmware files for the Intel Wifi 6000 devices supported by
	  the iwlwifi kernel driver.

config BR2_PACKAGE_LINUX_FIRMWARE_IWLWIFI_6000G2A
	bool "Intel iwlwifi 6000G2A"
	help
	  Firmware files for the Intel Wifi 6000G2A devices supported by
	  the iwlwifi kernel driver.

config BR2_PACKAGE_LINUX_FIRMWARE_IWLWIFI_6000G2B
	bool "Intel iwlwifi 6000G2B"
	help
	  Firmware files for the Intel Wifi 6000G2B devices supported by
	  the iwlwifi kernel driver.

config BR2_PACKAGE_LINUX_FIRMWARE_IWLWIFI_6250
	bool "Intel iwlwifi 6250"
	help
	  Firmware files for the Intel Wifi 6250 devices supported by
	  the iwlwifi kernel driver.

config BR2_PACKAGE_LINUX_FIRMWARE_IWLWIFI_7260
	bool "Intel iwlwifi 7260"
	help
	  Firmware files for the Intel Wifi 7260 devices supported by
	  the iwlwifi kernel driver.

config BR2_PACKAGE_LINUX_FIRMWARE_IWLWIFI_7265
	bool "Intel iwlwifi 7265"
	help
	  Firmware files for the Intel Wifi 7265 devices supported by
	  the iwlwifi kernel driver.

config BR2_PACKAGE_LINUX_FIRMWARE_IWLWIFI_7265D
	bool "Intel iwlwifi 7265D"
	# needed for old kernel versions, where the non-D and D
	# firmwares were the same
	select BR2_PACKAGE_LINUX_FIRMWARE_IWLWIFI_7265
	help
	  Firmware files for the Intel Wifi 7265D devices supported by
	  the iwlwifi kernel driver.

config BR2_PACKAGE_LINUX_FIRMWARE_IWLWIFI_8000C
	bool "Intel iwlwifi 8000C"
	help
	  Firmware files for the Intel Wifi 8000C devices supported by
	  the iwlwifi kernel driver.

config BR2_PACKAGE_LINUX_FIRMWARE_IWLWIFI_8265
	bool "Intel iwlwifi 8265"
	help
	  Firmware files for the Intel Wifi 8265 devices supported by
	  the iwlwifi kernel driver.

config BR2_PACKAGE_LINUX_FIRMWARE_IWLWIFI_9XXX
	bool "Intel iwlwifi 9xxx"
	help
	  Firmware files for the Intel Wifi 9xxx devices supported by
	  the iwlwifi kernel driver.

config BR2_PACKAGE_LINUX_FIRMWARE_IWLWIFI_22000
	bool "Intel iwlwifi 22000"
	help
	  Firmware files for the Intel Wifi 22000 devices supported by
	  the iwlwifi kernel driver.

config BR2_PACKAGE_LINUX_FIRMWARE_IWLWIFI_22260
	bool "Intel iwlwifi 22260"
	help
	  Firmware files for the Intel Wifi 22260 devices supported by
	  the iwlwifi kernel driver.

config BR2_PACKAGE_LINUX_FIRMWARE_LIBERTAS_SD8686_V8
	bool "Libertas SD 8686 v8"
	help
	  Firmware files (version 8) for the Marvell SD8686 module

config BR2_PACKAGE_LINUX_FIRMWARE_LIBERTAS_SD8686_V9
	bool "Libertas SD 8686 v9"
	help
	  Firmware files (version 9) for the Marvell SD8686 module

config BR2_PACKAGE_LINUX_FIRMWARE_LIBERTAS_SD8688
	bool "Libertas SD 8688"
	help
	  Firmware files for the Marvell SD8688 module

config BR2_PACKAGE_LINUX_FIRMWARE_LIBERTAS_8388
	bool "Libertas USB 8388"
	help
	  Firmware file for Libertas 8388 USB WLAN Thinfirm Driver

config BR2_PACKAGE_LINUX_FIRMWARE_LIBERTAS_USB8XXX
	bool "Libertas usb8xxx"
	help
	  Firmware files for 8388 USB WLAN driver

config BR2_PACKAGE_LINUX_FIRMWARE_LIBERTAS_CS
	bool "Libertas CS"
	help
	  Firmware files for the Marvell 83xx CF WLAN cards

config BR2_PACKAGE_LINUX_FIRMWARE_MRVL
	bool "Marvell WiFi-Ex"
	help
	  Firmware files for the Marvell WiFi-Ex driver (mwifiex)

config BR2_PACKAGE_LINUX_FIRMWARE_MWL8K
	bool "Marvell TOPDOG"
	help
	  Firmware files for the Marvell TOPDOG 802.11 Wireless Network Driver (mwl8k)

config BR2_PACKAGE_LINUX_FIRMWARE_ORINOCO
	bool "Orinoco"
	help
	  Firmware files for orinoco driver (orinoco)

config BR2_PACKAGE_LINUX_FIRMWARE_MWIFIEX_SD8787
	bool "Marvell Wifi-Ex 8787 SDIO"
	help
	  Firmware files for the Marvell Wifi-Ex 8787 module on SDIO.

config BR2_PACKAGE_LINUX_FIRMWARE_MWIFIEX_SD8797
	bool "Marvell Wifi-Ex 8797 SDIO"
	help
	  Firmware files for the Marvell Wifi-Ex 8797 module on SDIO.

config BR2_PACKAGE_LINUX_FIRMWARE_MWIFIEX_USB8797
	bool "Marvell Wifi-Ex 8797 USB"
	help
	  Firmware files for the Marvell Wifi-Ex 8797 module on USB.

config BR2_PACKAGE_LINUX_FIRMWARE_MWIFIEX_USB8801
	bool "Marvell Wifi-Ex 8801 USB"
	help
	  Firmware files for the Marvell Wifi-Ex 8801 module on USB.

config BR2_PACKAGE_LINUX_FIRMWARE_MWIFIEX_SD8887
	bool "Marvell Wifi-Ex 8887 SDIO"
	help
	  Firmware files for the Marvell Wifi-Ex 8887 module on SDIO.

config BR2_PACKAGE_LINUX_FIRMWARE_MWIFIEX_SD8897
	bool "Marvell Wifi-Ex 8897 SDIO"
	help
	  Firmware files for the Marvell Wifi-Ex 8897 module on SDIO.

config BR2_PACKAGE_LINUX_FIRMWARE_MWIFIEX_USB8897
	bool "Marvell Wifi-Ex 8897 USB"
	help
	  Firmware files for the Marvell Wifi-Ex 8897 module on USB.

config BR2_PACKAGE_LINUX_FIRMWARE_MWIFIEX_PCIE8897
	bool "Marvell Wifi-Ex 8897 PCI-E"
	help
	  Firmware files for the Marvell Wifi-Ex 8897 module on PCI-E.

config BR2_PACKAGE_LINUX_FIRMWARE_MEDIATEK_MT7601U
	bool "MediaTek MT7601U"
	help
	  MediaTek MT7601U

config BR2_PACKAGE_LINUX_FIRMWARE_QUALCOMM_6174
	bool "Qualcomm Atheros 6174"
	help
	  Firmware files for the Qualcomm Atheros QCA6174 chip

config BR2_PACKAGE_LINUX_FIRMWARE_RALINK_RT61
	bool "Ralink rt2501/rt61"
	help
	  Ralink rt2501/rt61

config BR2_PACKAGE_LINUX_FIRMWARE_RALINK_RT73
	bool "Ralink rt73"
	help
	  Ralink rt73

config BR2_PACKAGE_LINUX_FIRMWARE_RALINK_RT2XX
	bool "Ralink rt27xx/rt28xx/rt30xx"
	help
	  Ralink rt27xx/rt28xx/rt30xx

config BR2_PACKAGE_LINUX_FIRMWARE_RSI_91X
	bool "Redpine Signals 91x"
	help
	  Firmware for Redpine Signals RSI wireless USB devices (rsi_usb)

config BR2_PACKAGE_LINUX_FIRMWARE_RTL_8152
	bool "Realtek 8152/8153"
	help
	  Realtek 8152/8153 USB adapters

config BR2_PACKAGE_LINUX_FIRMWARE_RTL_81XX
	bool "Realtek 81xx"
	help
	  Realtek 8188/8192

config BR2_PACKAGE_LINUX_FIRMWARE_RTL_87XX
	bool "Realtek 87xx"
	help
	  Realtek 8712/8723/8723be

config BR2_PACKAGE_LINUX_FIRMWARE_RTL_88XX
	bool "Realtek 88xx"
	help
	  Realtek rtl8821ae

config BR2_PACKAGE_LINUX_FIRMWARE_REDPINE_RS9113
	bool "Redpine rs9113"
	help
	  Firmware files for WLAN and Bluetooth modules rs9113

config BR2_PACKAGE_LINUX_FIRMWARE_TI_WL127X
	bool "TI wl127x"
	help
	  Firmware files for WLAN and Bluetooth modules wl1271 and
	  wl1273

config BR2_PACKAGE_LINUX_FIRMWARE_TI_WL128X
	bool "TI wl128x"
	help
	  Firmware files for WLAN and Bluetooth modules wl128x

config BR2_PACKAGE_LINUX_FIRMWARE_TI_WL18XX
	bool "TI wl18xx"
	help
	  Firmware files for WLAN and Bluetooth modules wl18xx

endmenu

menu "Ethernet firmware"

config BR2_PACKAGE_LINUX_FIRMWARE_BNX2
	bool "Broadcom NetXtremeII"
	help
	  Firmware files for Broadcom NetXtreme 10Gb ethernet cards
	  (bnx2)

config BR2_PACKAGE_LINUX_FIRMWARE_BNX2X
	bool "Broadcom Everest"
	help
	  Firmware files for Broadcom Everest ethernet cards (bnx2x)

config BR2_PACKAGE_LINUX_FIRMWARE_BROADCOM_TIGON3
	bool "Broadcom Tigon3"
	help
	  Firmware files for the Broadcom Tigon3.

config BR2_PACKAGE_LINUX_FIRMWARE_BROCADE_BNA
	bool "Brocade 10G PCIe Ethernet driver"
	help
	  Firmware file for Brocade 10G PCIe Ethernet driver (bna)

config BR2_PACKAGE_LINUX_FIRMWARE_CXGB3
	bool "Chelsio T3"
	help
	  Firmware files for Chelsio T3 adapters (cxgb3)

config BR2_PACKAGE_LINUX_FIRMWARE_CXGB4_T4
	bool "Chelsio T4"
	help
	  Firmware files for Chelsio T4 1Gb and 10Gb ethernet cards
	  (cxgb4)

config BR2_PACKAGE_LINUX_FIRMWARE_CXGB4_T5
	bool "Chelsio T5"
	help
	  Firmware files for Chelsio T5 1Gb and 10Gb ethernet cards
	  (cxgb4)

config BR2_PACKAGE_LINUX_FIRMWARE_CXGB4_T6
	bool "Chelsio T6"
	help
	  Firmware files for Chelsio T6 1Gb and 10Gb ethernet cards (cxgb4)

config BR2_PACKAGE_LINUX_FIRMWARE_KAWETH
	bool "Support for Kaweth KL5KUSB101 USB"
	help
	  Firmware files for KL5KUSB101 based USB->Ethernet devices

config BR2_PACKAGE_LINUX_FIRMWARE_MYRICOM
	bool "Myricom 10G"
	help
	  Firmware files for Myricom 10G driver (myri10ge)

config BR2_PACKAGE_LINUX_FIRMWARE_NETXEN_QLCNIC
	bool "NetXen / QLogic"
	help
	  Firmware file for QLogic/NetXen (1/10) Converged/Intelligent Ethernet Driver (netxen_nic / qlcnic)

config BR2_PACKAGE_LINUX_FIRMWARE_RTL_8169
	bool "Realtek 8169"
	help
	  Firmware files for Realtek 8169 gigabit ethernet cards

endmenu

menu "WiMAX firmware"

config BR2_PACKAGE_LINUX_FIRMWARE_INTEL_I2400
	bool "Intel i2400m-usb"
	help
	  Firmware files for the Intel WiMAX i2400 devices supported by
	  the i2400m-usb kernel driver.

if BR2_PACKAGE_LINUX_FIRMWARE_INTEL_I2400

choice
	bool "i2400m-usb revision to use"
	help
	  Use revision 4
	  Use revision 5

config BR2_PACKAGE_LINUX_FIRMWARE_INTEL_I2400_4
	prompt "revision 4"
	help
	  Use revision 4

config BR2_PACKAGE_LINUX_FIRMWARE_INTEL_I2400_5
	prompt "revision 5"
	help
	  Use revision 5

endchoice

config BR2_PACKAGE_LINUX_FIRMWARE_INTEL_I2400_REV
	int
	default 4 if BR2_PACKAGE_LINUX_FIRMWARE_INTEL_I2400_4
	default 5 if BR2_PACKAGE_LINUX_FIRMWARE_INTEL_I2400_5

endif # i2400m-usb

endmenu

menu "DVB firmware"

config BR2_PACKAGE_LINUX_FIRMWARE_AS102
	bool "Abilis Systems as102"
	help
	  Firmware file for Abilis Systems single DVB-T receiver as102

config BR2_PACKAGE_LINUX_FIRMWARE_DIB0700
	bool "DiBcom dib0700"
	help
	  Firmware file for dib0700-based USB DVB tuner driver

config BR2_PACKAGE_LINUX_FIRMWARE_ITETECH_IT9135
	bool "ITEtech it9135"
	help
	  Firmware files for ITEtech it9135 (Ax and Bx) DVB-T USB tuner

config BR2_PACKAGE_LINUX_FIRMWARE_H5_DRXK
	bool "Terratec H5 DRX-K"
	help
	  Firmware file for Terratec H5 DRX-K based DVB tuner driver

config BR2_PACKAGE_LINUX_FIRMWARE_XCx000
	bool "Xceive/Cresta xc4000/xc5000/xc500c"
	help
	  Firmware file for xc4000/xc5000/xc5000c based DVB tuner driver

endmenu

menu "SoC Firmware"

config BR2_PACKAGE_LINUX_FIRMWARE_IMX_SDMA
	bool "Freescale i.MX SDMA"
	help
	  Firmware files for i.MX SDMA.

endmenu

menu "USB-Serial firmware"

config BR2_PACKAGE_LINUX_FIRMWARE_KEYSPAN
	bool "Keyspan USB-Serial"
	help
	  Firmware files for keyspan USB-Serial converter (keyspan)

endmenu

menu "Fibre Channel Adapter Firmware"

config BR2_PACKAGE_LINUX_FIRMWARE_QLOGIC_2XXX
	bool "QLogic 2xxx Fibre Channel Adapters"
	help
	  Firmware files for ql2xxx adapters

endmenu

menu "Intel QuickAssist Firmware"

config BR2_PACKAGE_LINUX_FIRMWARE_QAT_DH895XCC
	bool "Support for DH895xCC"
	help
	  Firmware files for Intel DH895xCC devices

config BR2_PACKAGE_LINUX_FIRMWARE_QAT_C3XXX
	bool "Support for C3XXX"
	help
	  Firmware files for Intel C3XXX devices

config BR2_PACKAGE_LINUX_FIRMWARE_QAT_C62X
	bool "Support for C62X"
	help
	  Firmware files for Intel C62X devices

endmenu

endif
```

## src/packages/src/src/fbr/buildroot/package/lpdsrv/Config.in
```kconfig
config BR2_PACKAGE_LPDSRV
	bool "lpdsrv"
	help
	  Non Spooling LPD server (RFC1179).
```

## src/packages/src/src/fbr/buildroot/package/lptkeys/Config.in
```kconfig
config BR2_PACKAGE_LPTKEYS
	bool "lptkeys"
	help
	  Allows to control a fli4l over switches connected to the parallel
	  port.

	  http://www.ehnert.net/LCD.html
```
